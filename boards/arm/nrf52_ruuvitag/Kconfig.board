## boards/arm/nrf52_ruuvitag/Kconfig.board
```kconfig
# Kconfig - nRF52 Ruuvi Tag board configuration
#
# Copyright (c) 2017 Peter Robinson
#
# SPDX-License-Identifier: Apache-2.0

config BOARD_NRF52_RUUVITAG
	bool "nRF52 Ruuvi Tag"
	depends on SOC_NRF52832_QFAA
```
